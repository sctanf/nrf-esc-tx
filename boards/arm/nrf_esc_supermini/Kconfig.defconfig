## boards/arm/nrf_esc_supermini/Kconfig.defconfig
```kconfig
# Copyright (c) 2024 Nordic Semiconductor ASA
# SPDX-License-Identifier: Apache-2.0

if BOARD_FANPUMP_SUPERMICRO_TX

config BOARD
	default "nrf-esc-supermini"

config BT_CTLR
   default BT


endif
```
